/*
 * tegra186-vcm31-p2382-common.dtsi: tegra186-vcm31-p2382-common dtsi for k4.4
 *
 * Copyright (c) 2016, NVIDIA CORPORATION.  All rights reserved.
 *
 * This program is free software; you can redistribute it and/or modify
 * it under the terms of the GNU General Public License as published by
 * the Free Software Foundation; version 2 of the License.
 *
 * This program is distributed in the hope that it will be useful, but WITHOUT
 * ANY WARRANTY; without even the implied warranty of MERCHANTABILITY or
 * FITNESS FOR A PARTICULAR PURPOSE.  See the GNU General Public License for
 * more details.
 */

/ {
        sdhci@3460000 { /* SDMMC_D: Used for eMMc */
		uhs-mask = <0x60>;   /* Disable HS200/HS400 */
		status = "okay";
        };

	sdhci@3400000 {
		/* 7F: disable all UHS mode */
                uhs-mask = <0x7F>;
		vqmmc-supply = <&spmic_ldo3>;
		vmmc-supply = <&en_vdd_sdcard1>;
		vddio_sdmmc-supply = <0x0>;
		vddio_sd_slot-supply = <0x0>;
		cd-inverted;
		wp-inverted;
		status = "okay";
	};

	sdhci@3440000 {
		/* 7F: disable all UHS mode */
                uhs-mask = <0x7F>;
		vqmmc-supply = <&spmic_ldo5>;
		vmmc-supply = <&en_vdd_sdcard3>;
		vddio_sdmmc-supply = <0x0>;
		vddio_sd_slot-supply = <0x0>;
		cd-inverted;
		wp-inverted;
		status = "okay";
	};
};
