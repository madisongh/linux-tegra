/*
 * arch/arm/boot/dts/tegra124-p2360-480p-b00.dts
 *
 * Copyright (c) 2014-2015, NVIDIA CORPORATION.  All rights reserved.
 *
 * This program is free software; you can redistribute it and/or modify
 * it under the terms of the GNU General Public License as published by
 * the Free Software Foundation; version 2 of the License.
 *
 * This program is distributed in the hope that it will be useful, but WITHOUT
 * ANY WARRANTY; without even the implied warranty of MERCHANTABILITY or
 * FITNESS FOR A PARTICULAR PURPOSE.  See the GNU General Public License for
 * more details.
 *
 * You should have received a copy of the GNU General Public License along
 * with this program; if not, write to the Free Software Foundation, Inc.,
 * 51 Franklin Street, Fifth Floor, Boston, MA  02110-1301, USA.
 *
 */

/*
 * Applicable to all below revisions of P2360
 * A00, A01, A03, B00
 */

/* Include the b00 dts source and only modify edid */
#include "tegra124-p2360-b00.dts"

/ {
	host1x {
		hdmi {
			hdmi-display {
				nvidia,edid = [00 FF FF FF FF FF FF 00 04 21 00 00 00 00 00 00
					       01 00 01 03 00 00 00 00 00 00 00 00 00 00 00 00
					       00 00 00 00 00 00 01 01 01 01 01 01 01 01 01 01
					       01 01 01 01 01 01 FE 0C 20 00 31 E0 2D 10 40 40
					       43 00 00 00 00 00 00 00 00 00 00 10 00 00 00 00
					       00 00 00 00 00 00 00 00 00 00 00 00 00 10 00 00
					       00 00 00 00 00 00 00 00 00 00 00 00 00 00 00 10
					       00 00 00 00 00 00 00 00 00 00 00 00 00 00 00 61];
			};
		};
	};
};
