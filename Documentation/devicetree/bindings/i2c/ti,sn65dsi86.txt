## Documentation/devicetree/bindings/i2c/ti,sn65dsi86.txt
```
TI SN65DSI86 MIPI DSI to EDP Bridge
===================================

The sn65dsi86 node:
sn65dsi86 node must be contained in i2c parent node. This node represents
TI SN65DSI86 MIPI DSI to EDP Bridge.

Required properties:
- compatible: Should contain "ti,sn65dsi86".
- reg: I2C address for chip.

Optional properties:
- ti,enable-gpio: gpio to enable and reset chip.
- ti,pll-refclk-cfg: is the value for SN65DSI86_PLL_REFCLK_CFG register.
- ti,dsi-cha-clk-range: is the value for SN65DSI86_DSI_CHA_CLK_RANGE register.
- ti,disable-assr: can be 0 or 1 to enable or disable ASSR support.
  Default is set to zero.
- ti,dp-ssc-cfg: is the value for SN65DSI86_DP_SSC_CFG register.
- ti,h-pulse-width-low: is the value for SN65DSI86_CHA_HSYNC_PULSE_WIDTH_LOW
  register.
- ti,h-pulse-width-high: is the value for SN65DSI86_CHA_HSYNC_PULSE_WIDTH_HEIGH
  register.
- ti,v-pulse-width-low: is the value for SN65DSI86_CHA_VSYNC_PULSE_WIDTH_LOW
  register.
- ti,v-pulse-width-high: is the value for SN65DSI86_CHA_VSYNC_PULSE_WIDTH_HIGH
  register.
- ti,h-back-porch: is the value for SN65DSI86_CHA_HORIZONTAL_BACK_PORCH
  register.
- ti,v-back-porch: is the value for SN65DSI86_CHA_VERTICAL_BACK_PORCH register.
- ti,h-front-porch: is the value for SN65DSI86_CHA_HORIZONTAL_FRONT_PORCH
  register.
- ti,v-front-porch: is the value for SN65DSI86_CHA_VERTICAL_FRONT_PORCH
  register.

Example:

i2c@7000c000 {
	sn65dsi86@2d {
		compatible = "ti,sn65dsi86";
		reg = <0x2d>;
		status = "okay";
	};
}:
```

## arch/arm/mach-tegra/Kconfig
```kconfig
if ARCH_TEGRA

comment "NVIDIA Tegra options"

config ARCH_TEGRA_2x_SOC
	bool "Enable support for Tegra20 family"
	select ARCH_NEEDS_CPU_IDLE_COUPLED if SMP
	select ARM_ERRATA_720789
	select ARM_ERRATA_742230 if SMP
	select ARM_ERRATA_751472
	select ARM_ERRATA_754327 if SMP
	select ARM_ERRATA_764369 if SMP
	select ARM_GIC
	select CPU_V7
	select PINCTRL
	select PINCTRL_TEGRA20
	select PL310_ERRATA_727915 if CACHE_L2X0
	select PL310_ERRATA_769419 if CACHE_L2X0
	select USB_ARCH_HAS_EHCI if USB_SUPPORT
	select USB_ULPI if USB_PHY
	select USB_ULPI_VIEWPORT if USB_PHY
	help
	  Support for NVIDIA Tegra AP20 and T20 processors, based on the
	  ARM CortexA9MP CPU and the ARM PL310 L2 cache controller

config ARCH_TEGRA_3x_SOC
	bool "Enable support for Tegra30 family"
	select ARM_ERRATA_743622
	select ARM_ERRATA_751472
	select ARM_ERRATA_754322
	select ARM_ERRATA_764369 if SMP
	select ARM_GIC
	select CPU_V7
	select PINCTRL
	select PINCTRL_TEGRA30
	select PL310_ERRATA_769419 if CACHE_L2X0
	select USB_ARCH_HAS_EHCI if USB_SUPPORT
	select USB_ULPI if USB_PHY
	select USB_ULPI_VIEWPORT if USB_PHY
	help
	  Support for NVIDIA Tegra T30 processor family, based on the
	  ARM CortexA9MP CPU and the ARM PL310 L2 cache controller

config TEGRA_BBC_PROXY
	bool "Enable BBC Proxy driver"
	default n
	help
	  Enables driver which handles miscellaneous services required
	  by the BB core. Handles initialization of EDP, ISO Bandwidth,
	  and Latency Allowance settings. Additional setting adjustments
	  can be done from user space through sysfs.

config TEGRA_BBC_THERMAL
	bool "Enable BBC Thermal reporting support"
	depends on NVSHM
	depends on TEGRA_BBC_PROXY
	default y
	help
	  Enables the reporting of BBC-managed temperature sensors values as
	  thermal zones.  This uses the statistics framework where the data
	  reside, and thus depends on the NVSHM driver to provides the API to
	  browse the BBC statistics and be notified of modem [re-]boot.

config TEGRA_BASEBAND
	bool "Enable integrated tegra baseband support"
	default n
	help
	  This option enables support for integrated icera baseband
	  This driver is used to setup shared memory space, provide
	  functions to handle IPC mechanism and a sysfs interface for IPC
	  notification which support polling on sysfs file.

config TEGRA_BASEBAND_SIMU
	bool "Enable integrated tegra baseband simulation"
	select TEGRA_BASEBAND
	help
	  This option enables tegra baseband simulation when actual hardware
	  is not present. IPC is simulated when writing to status file which
	  allow high level tests in local loopback

config TEGRA_PCI
	bool "PCI Express support"
	depends on ARCH_TEGRA_2x_SOC
	select PCI

config TEGRA_AHB
	bool "Enable AHB driver for NVIDIA Tegra SoCs"
	default y
	help
	  Adds AHB configuration functionality for NVIDIA Tegra SoCs,
	  which controls AHB bus master arbitration and some
	  performance parameters(priority, prefech size).

comment "Tegra board type"

config TEGRA_EMC_SCALING_ENABLE
	bool "Enable scaling the memory frequency"

endif
```

## arch/arm64/configs/tegra_t186ref_gnu_linux_early_boot_defconfig
```kconfig
CONFIG_ARCH_TEGRA_18x_SOC=y
# CONFIG_LOCALVERSION_AUTO is not set
# CONFIG_SWAP is not set
# CONFIG_CROSS_MEMORY_ATTACH is not set
# CONFIG_USELIB is not set
CONFIG_NO_HZ=y
CONFIG_HIGH_RES_TIMERS=y
CONFIG_BLK_DEV_INITRD=y
CONFIG_CC_OPTIMIZE_FOR_SIZE=y
# CONFIG_KALLSYMS is not set
# CONFIG_SHMEM is not set
CONFIG_EMBEDDED=y
# CONFIG_VM_EVENT_COUNTERS is not set
CONFIG_SLAB=y
# CONFIG_BLK_DEV_BSG is not set
# CONFIG_IOSCHED_DEADLINE is not set
CONFIG_ARCH_TEGRA=y
CONFIG_PREEMPT=y
CONFIG_CMA=y
# CONFIG_EFI is not set
# CONFIG_COREDUMP is not set
CONFIG_COMPAT=y
# CONFIG_SUSPEND is not set
# CONFIG_WAKELOCK is not set
CONFIG_NET=y
CONFIG_PACKET=y
CONFIG_INET=y
# CONFIG_INET_XFRM_MODE_TRANSPORT is not set
# CONFIG_INET_XFRM_MODE_TUNNEL is not set
# CONFIG_INET_XFRM_MODE_BEET is not set
# CONFIG_INET_DIAG is not set
# CONFIG_IPV6 is not set
# CONFIG_WIRELESS is not set
# CONFIG_TEGRA_AHB is not set
CONFIG_DEVTMPFS=y
CONFIG_DEVTMPFS_MOUNT=y
# CONFIG_ALLOW_DEV_COREDUMP is not set
CONFIG_DMA_CMA=y
CONFIG_CMA_SIZE_MBYTES=64
# CONFIG_BLK_DEV is not set
CONFIG_TEGRA_FUSE=y
CONFIG_NETDEVICES=y
# CONFIG_NET_VENDOR_AMD is not set
# CONFIG_NET_VENDOR_ARC is not set
# CONFIG_NET_VENDOR_BROADCOM is not set
# CONFIG_NET_VENDOR_INTEL is not set
# CONFIG_NET_VENDOR_MARVELL is not set
# CONFIG_NET_VENDOR_MICREL is not set
# CONFIG_NET_VENDOR_NATSEMI is not set
# CONFIG_NET_VENDOR_QUALCOMM is not set
# CONFIG_NET_VENDOR_SAMSUNG is not set
# CONFIG_NET_VENDOR_SEEQ is not set
# CONFIG_NET_VENDOR_SMSC is not set
# CONFIG_NET_VENDOR_STMICRO is not set
# CONFIG_NET_VENDOR_VIA is not set
# CONFIG_NET_VENDOR_WIZNET is not set
# CONFIG_WLAN is not set
CONFIG_TEGRA_HV_NET=y
# CONFIG_INPUT_MOUSEDEV is not set
# CONFIG_INPUT_KEYBOARD is not set
# CONFIG_INPUT_MOUSE is not set
# CONFIG_SERIO is not set
# CONFIG_VT is not set
# CONFIG_UNIX98_PTYS is not set
# CONFIG_LEGACY_PTYS is not set
# CONFIG_DEVKMEM is not set
CONFIG_SERIAL_8250=y
CONFIG_SERIAL_8250_CONSOLE=y
CONFIG_SERIAL_OF_PLATFORM=y
CONFIG_TEGRA_HV_COMM=y
# CONFIG_HW_RANDOM is not set
# CONFIG_SYSTEM_PMIC is not set
# CONFIG_HWMON is not set
CONFIG_WATCHDOG=y
CONFIG_WATCHDOG_CORE=y
CONFIG_TEGRA_HV_WATCHDOG=y
CONFIG_REGULATOR=y
CONFIG_REGULATOR_DUMMY=y
# CONFIG_TEGRA_NVMAP is not set
# CONFIG_TEGRA_DP is not set
# CONFIG_TEGRA_CAMERA_PLATFORM is not set
# CONFIG_HID is not set
# CONFIG_USB_SUPPORT is not set
CONFIG_DMADEVICES=y
CONFIG_TEGRA186_GPC_DMA=y
CONFIG_VIRT_DRIVERS=y
CONFIG_TEGRA_VIRTUALIZATION=y
CONFIG_TEGRA_HV_MANAGER=y
CONFIG_TEGRA_VIRT_SUPPORT_BOOTDATA=y
# CONFIG_TEGRA3_PM is not set
# CONFIG_TEGRA_POWERGATE is not set
CONFIG_TEGRA_BWMGR=y
# CONFIG_TEGRA_FIRMWARES_INVENTORY is not set
# CONFIG_TEGRA_AON is not set
# CONFIG_COMMON_CLK_XGENE is not set
CONFIG_ARM_SMMU=y
# CONFIG_GK20A is not set
CONFIG_TEGRA_BPMP=y
# CONFIG_DNOTIFY is not set
# CONFIG_PROC_SYSCTL is not set
# CONFIG_MISC_FILESYSTEMS is not set
# CONFIG_NETWORK_FILESYSTEMS is not set
CONFIG_PRINTK_TIME=y
# CONFIG_SCHED_DEBUG is not set
# CONFIG_DEBUG_PREEMPT is not set
CONFIG_STACKTRACE=y
# CONFIG_DEBUG_BUGVERBOSE is not set
# CONFIG_FTRACE is not set
CONFIG_CRYPTO_LZO=y
```

## drivers/cpuidle/Kconfig.arm64
```kconfig
#
# ARM64 CPU Idle drivers
#

config ARM64_CPUIDLE
	bool "Generic ARM64 CPU idle Driver"
	select ARM64_CPU_SUSPEND
	select DT_IDLE_STATES
	help
	  Select this to enable generic cpuidle driver for ARM64.
	  It provides a generic idle driver whose idle states are configured
	  at run-time through DT nodes. The CPUidle suspend backend is
	  initialized by calling the CPU operations init idle hook
	  provided by architecture code.

config CPU_IDLE_DENVER
	bool "CPU Idle Driver for NVIDIA Denver processors"
	depends on DENVER_CPU
	default y
	help
	  Select this to enable cpuidle on NVIDIA Denver processors.
```

## drivers/padctrl/Kconfig
```kconfig
menuconfig PADCTRL
	bool "Pad controller support"
	help
	  Say Y here to enable pad controller support

	  This framework provides a generic interface to PAD
	  devices.

if PADCTRL
config PADCTRL_GENERIC_TEGRA_IO_PAD
	bool "Generic Tegra IO Pad control driver"
	depends on ARCH_OR_PLATFORM_TEGRA
	help
	  This option enables Genric Tegra IO PAD padctrl driver

	  Tegra IO Pad padctrl driver which controls the IO pad
	  configuration for 1.2V, 1.8V and 3.3V.

config PADCTRL_TEGRA210_PMC
	bool "Tegra210 PMC PADCTRL driver"
	depends on ARCH_TEGRA
	help
	  This option enables Tegra 210 PMC padctrl driver

	  Tegra210 PMC padctrl driver which controls the pad
	  to supply either 1.8V or 3.3V.

trysource "../t18x/drivers/padctrl/Kconfig"
trysource "../t18x/drivers/padctrl/Kconfig.t18x"
trysource "drivers/padctrl/Kconfig.t18x"
endif
```

## drivers/video/tegra/Kconfig
```kconfig
trysource "nvidia/nvhost/drivers/video/tegra/Kconfig"
trysource "nvidia/nvhost/drivers/video/tegra/Kconfig.nvhost"
trysource "drivers/video/tegra/Kconfig.nvhost"

config TEGRA_GRHOST_SYNC
	depends on TEGRA_GRHOST || TEGRA_HOST1X
	bool "Tegra host synchronization objects"
	default y
	select SYNC
	help
	  Add tegra host backend for the cross driver synchronization framework.
	  Allows creating sync fence file descriptors from Tegra host syncpoints.

trysource "nvidia/nvmap/drivers/video/tegra/nvmap/Kconfig"
trysource "nvidia/nvmap/drivers/video/tegra/nvmap/Kconfig.nvmap"
trysource "drivers/video/tegra/nvmap/Kconfig.nvmap"

if ARCH_TEGRA

config TEGRA_GR_VIRTUALIZATION
	bool "Tegra graphics virtualization support"
	default n
	depends on TEGRA_HV_MANAGER
	help
	  Adds Tegra graphics virtualization (host and gpu) support to client
	  drivers.

config TEGRA_DC
	tristate "Tegra Display Contoller"
	depends on (TEGRA_GRHOST || TEGRA_HOST1X) && I2C
	select BACKLIGHT_CLASS_DEVICE
	select FB_MODE_HELPERS
	help
	  Tegra display controller support.
	  Enable this to access the Tegra display controller using either framebuffer
	  console interface and a proprietary dc-ext interface or with ADF.

trysource nvidia/display/drivers/video/tegra/Kconfig
trysource "nvidia/display/drivers/video/tegra/Kconfig.display"
trysource "drivers/video/tegra/Kconfig.display"

config TEGRA_CAMERA_PLATFORM
	bool "Enable tegra camera platform driver"
	depends on ARCH_TEGRA
	default y
	help
	  Enables tegra camera platform driver.
	  If unsure, say Y

endif
```
